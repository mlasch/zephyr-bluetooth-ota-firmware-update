## west.yml
```yaml
manifest:
  remotes:
    - name: zephyrproject-rtos
      url-base: https://github.com/zephyrproject-rtos
  projects:
    - name: zephyr
      remote: zephyrproject-rtos
      revision: main
      path: zephyr
      import:
        name-allowlist:
          - cmsis
          - hal_espressif
          - hal_nordic
          - littlefs
          - mbedtls
          - mcuboot
          - mcumgr
          - segger
          - tinycbor
          - tinycrypt
          - zcbor

  self:
    # This repository should be cloned to
    path: app
```
